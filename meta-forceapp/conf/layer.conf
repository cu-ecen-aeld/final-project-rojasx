## meta-forceapp/conf/layer.conf
```bitbake
# We have a conf and classes directory, add to BBPATH
BBPATH .= ":${LAYERDIR}"

# We have recipes-* directories, add to BBFILES
BBFILES += "${LAYERDIR}/recipes-*/*/*.bb \
            ${LAYERDIR}/recipes-*/*/*.bbappend"

BBFILE_COLLECTIONS += "meta-forceapp"
BBFILE_PATTERN_meta-forceapp = "^${LAYERDIR}/"
BBFILE_PRIORITY_meta-forceapp = "6"

LAYERDEPENDS_meta-forceapp = "core"
LAYERSERIES_COMPAT_meta-forceapp = "scarthgap"
```
